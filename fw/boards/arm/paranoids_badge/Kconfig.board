## fw/boards/arm/paranoids_badge/Kconfig.board
```kconfig
config BOARD_PARANOIDS_BADGE
	bool "Paranoids Blinky Badge"
	depends on SOC_NRF52833_QIAA
```

## fw/boards/arm/paranoids_badge/Kconfig.defconfig
```kconfig
if BOARD_PARANOIDS_BADGE

config BOARD
	default "paranoids_badge"

config IEEE802154_NRF5
	default y
	depends on IEEE802154

config BT_CTLR
	default BT

endif # BOARD_PARANOIDS_BADGE
```

## fw/boards/arm/paranoids_badge/paranoids_badge_defconfig
```kconfig
CONFIG_SOC_SERIES_NRF52X=y
CONFIG_SOC_NRF52833_QIAA=y
CONFIG_BOARD_PARANOIDS_BADGE=y

# Enable MPU
CONFIG_ARM_MPU=y

# Enable RTT
CONFIG_USE_SEGGER_RTT=y

# enable GPIO
CONFIG_GPIO=y

# enable uart driver
CONFIG_SERIAL=y

# enable console
CONFIG_CONSOLE=y
CONFIG_UART_CONSOLE=y

# additional board options
CONFIG_GPIO_AS_PINRESET=y

# 32kHz clock source
CONFIG_CLOCK_CONTROL_NRF_K32SRC_RC=y
CONFIG_CLOCK_CONTROL_NRF_K32SRC_500PPM=y

# NFC
CONFIG_NFC_T2T_NRFXLIB=y
CONFIG_NFC_NDEF=y
CONFIG_NFC_NDEF_MSG=y
CONFIG_NFC_NDEF_RECORD=y
CONFIG_NFC_NDEF_TEXT_RECORD=y

# BLE
CONFIG_BT=y
CONFIG_BT_OBSERVER=y
CONFIG_BT_BROADCASTER=y

# USB
CONFIG_USB_DEVICE_STACK=y
CONFIG_USB_DEVICE_PRODUCT="Paranoids Blinky Badge"

# Audio
CONFIG_AUDIO=y
CONFIG_AUDIO_DMIC=y

# SPI for LEDs
CONFIG_SPI=y

# PWM for eyes
CONFIG_PWM=y

# NVS
CONFIG_FLASH=y
CONFIG_NVS=y

# Sound processing uses floats
CONFIG_FPU=y

# Cute
CONFIG_BT_EXT_ADV=y
CONFIG_BT_EXT_ADV_MAX_ADV_SET=3
```
